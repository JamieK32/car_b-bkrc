// 
// 
// 

#include "BEEP.h"

_BEEP	BEEP;

_BEEP::_BEEP()
{
}

_BEEP::~_BEEP()
{
}

/************************************************************************************************************
【函 数 名】：	Initialization		初始化函数
【参数说明】：	无
【返 回 值】：	无
【简    例】：	Initialization();	初始化任务板蜂鸣器引脚
************************************************************************************************************/
void _BEEP::Initialization(void)
{
	//pin = _pin;
	pinMode(BEEP_PIN, OUTPUT);
	TurnOff();
}

/************************************************************************************************************
【函 数 名】：	TurnOn			打开任务板蜂鸣器函数
【参数说明】：	无
【返 回 值】：	无
【简    例】：	TurnOn();		打开任务板蜂鸣器
************************************************************************************************************/
void _BEEP::TurnOn(void)
{
	digitalWrite(BEEP_PIN, BEEP_ON);
}

/************************************************************************************************************
【函 数 名】：	TurnOff			关闭任务板蜂鸣器函数
【参数说明】：	无
【返 回 值】：	无
【简    例】：	TurnOff();		关闭任务板蜂鸣器
************************************************************************************************************/
void _BEEP::TurnOff(void)
{
	digitalWrite(BEEP_PIN, BEEP_OFF);
}

void Sound(int frq)
{
    u32 time;
    if (frq != 1000)
    {
        time = 500000 / ((u32)frq);
        digitalWrite(BEEP_PIN, 1);
        delay(time/1000);
        digitalWrite(BEEP_PIN, BEEP_OFF);
        delay(time/1000);
    }
    else
    {
        digitalWrite(BEEP_PIN, BEEP_OFF);
        delay(1);
    }

}

void play_music(void)
{
    //              低7  1   2   3   4   5   6   7  高1 高2 高3 高4 高5 不发音
    int tone[] = { 247,262,294,330,349,392,440,294,523,587,659,698,784,1000,1047,1175,1319,1397,1568,1760,1976 };//音频数据表
    //红尘情歌
    u8 music[] =
    {
        5,5,6,8,7,6,5,6,13,13,//音调
        5,5,6,8,7,6,5,3,13,13,
        2,2,3,5,3,5,6,3,2,1,
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        6,10,9,9,8,6,5,6,8
    };
    u8 time[] =
    {
        2,4,2,2,2,2,2,8,4, 4, //时间
        2,4,2,2,2,2,2,8,4, 4,
        2,4,2,4,2,2,4,2,2,8,
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        2,2 ,2,4,2,4,2,2,12
    };
    u32 yanshi;
    int i, e;
    yanshi = 10;
    for (i = 0; i < sizeof(music) / sizeof(music[0]); i++)
    {
        for (e = 0; e < ((int)time[i]) * tone[music[i]] / yanshi; e++)
        {
            Sound((u32)tone[music[i]]);
        }
    }


    
}
